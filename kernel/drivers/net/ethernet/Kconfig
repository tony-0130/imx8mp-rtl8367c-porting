## kernel/drivers/net/ethernet/Kconfig
```kconfig
# SPDX-License-Identifier: GPL-2.0-only
#
# Ethernet LAN device configuration
#

menuconfig ETHERNET
	bool "Ethernet driver support"
	depends on NET
	default y
	help
	  This section contains all the Ethernet device drivers.

if ETHERNET

config MDIO
	tristate
	
config SUNGEM_PHY
	tristate
	
source "drivers/net/ethernet/rtl8367/Kconfig"

endif # ETHERNET
```
